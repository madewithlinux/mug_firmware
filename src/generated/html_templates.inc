// this is generated code, do not edit!
// generated by web/transform_template.py

// source: aaa_macros.html
#define FORM_INPUT(varname) \
    response->print("<p><label>"); \
    response->print(#varname); \
    response->print(": <input id=\""); \
    response->print(#varname); \
    response->print("\" name=\""); \
    response->print(#varname); \
    response->print("\" type=\"number\" min=\"0\" step=\"0.1\" value=\""); \
    response->printf("%.01f", varname); \
    response->print("\" /></label> </p>");
#define FORM_INPUT_INT(varname) \
    response->print("<p><label>"); \
    response->print(#varname); \
    response->print(": <input id=\""); \
    response->print(#varname); \
    response->print("\" name=\""); \
    response->print(#varname); \
    response->print("\" type=\"number\" min=\"0\" step=\"0.1\" value=\""); \
    response->printf("%i", varname); \
    response->print("\" /></label> </p>");
#define STATUS_LINE(varname) \
    response->print("<p>"); \
    response->print(#varname); \
    response->print(": "); \
    response->print(varname); \
    response->print(" </p>");

// source: control_page.html
#define CONTROL_PAGE_SIZE_ESTIMATE 1900
void write_control_page(AsyncResponseStream* response) {
   response->print("<!DOCTYPE html> <html> <head> <title>Mug</title> <meta charset=\"UTF-8\"> <meta name=\"viewport\" content=\"width=device-width, initial-scale=1\"> <style> body { margin: 20px; } </style> </head> <body> <a href=\"/\"> <h1>Mug</h1> </a> <p> <a href=\"/\">refresh</a> <a href=\"/system-info\">system info</a> </p> <p> uptime: ");
   response->printf("%02i", uptimeH);
   response->print(":");
   response->printf("%02i", uptimeM);
   response->print(":");
   response->printf("%02i", uptimeS);
   response->print(" </p> <form action=\"/update-config\" method=\"post\"> <p>heater state: ");
   response->print(is_heater_on ? "ON" : "OFF");
   response->print(" (level=");
   response->print(pwm_output);
   response->print(")</p> <p>current_temp_f: ");
   response->printf("%.02f", current_temp_f);
   response->print("</p> ");
   FORM_INPUT(target_temp_f)
   response->print(" ");
   FORM_INPUT(threshold_temp_f)
   response->print(" ");
   FORM_INPUT(temp_hot)
   response->print(" ");
   FORM_INPUT(temp_cold)
   response->print(" ");
   FORM_INPUT(refresh_interval)
   response->print(" <br/> ");
   FORM_INPUT(Kp)
   response->print(" ");
   FORM_INPUT(Ki)
   response->print(" ");
   FORM_INPUT(Kd)
   response->print(" <br/> ");
   FORM_INPUT_INT(led_brightness)
   response->print(" <input type=\"submit\" value=\"save\"> </form> </body> <script> for (const e of document.getElementsByTagName(\"input\")) { e.onchange = () => { window.dirty = true; console.log('auto-refresh disabled'); }; }; const interval = setInterval(() => { if (!window.dirty) { location.reload(); } }, ");
   response->print( refresh_interval*1000 );
   response->print("); </script> </html>");
}

// source: system_info_page.html
#define SYSTEM_INFO_PAGE_SIZE_ESTIMATE 2218
void write_system_info_page(AsyncResponseStream* response) {
   response->print("<!DOCTYPE html> <html> <head> <title>Mug system info</title> <meta charset=\"UTF-8\"> <meta name=\"viewport\" content=\"width=device-width, initial-scale=1\"> <style> body { margin: 20px; } </style> </head> <body> <a href=\"/system-info\"> <h1>Mug system info</h1> </a> <p> <a href=\"/system-info\">refresh</a> <a href=\"/\">back to control page</a> </p> <form action=\"/update-config\" method=\"post\"> ");
   FORM_INPUT(refresh_interval)
   response->print(" <input type=\"submit\" value=\"save\"> </form>  <div>  <h2>temperature</h2> ");
   STATUS_LINE(is_heater_on)
   response->print(" <p>current_temp_f: ");
   response->printf("%.08f", current_temp_f);
   response->print("</p> ");
   STATUS_LINE(target_temp_f)
   response->print(" ");
   STATUS_LINE(threshold_temp_f)
   response->print(" <h2>PID</h2> ");
   STATUS_LINE(Setpoint)
   response->print(" ");
   STATUS_LINE(Input)
   response->print(" ");
   STATUS_LINE(Output)
   response->print(" ");
   STATUS_LINE(Kp)
   response->print(" ");
   STATUS_LINE(Ki)
   response->print(" ");
   STATUS_LINE(Kd)
   response->print(" <h2>LED</h2> ");
   STATUS_LINE(get_led_state_str())
   response->print(" <h2>network</h2> ");
   STATUS_LINE(WiFi.macAddress())
   response->print(" ");
   STATUS_LINE(WiFi.status())
   response->print(" ");
   STATUS_LINE(WiFi.localIP())
   response->print(" ");
   STATUS_LINE(WiFi.RSSI())
   response->print(" ");
   STATUS_LINE(WiFi.SSID())
   response->print(" ");
   STATUS_LINE(WiFi.BSSIDstr())
   response->print(" ");
   STATUS_LINE(WiFi.gatewayIP())
   response->print(" ");
   STATUS_LINE(MDNS.isRunning())
   response->print(" <h2>ESP system</h2> ");
   STATUS_LINE(loops_per_second)
   response->print(" ");
   STATUS_LINE(ESP.getResetReason())
   response->print(" ");
   STATUS_LINE(ESP.getFreeHeap())
   response->print(" ");
   STATUS_LINE(ESP.getHeapFragmentation())
   response->print(" ");
   STATUS_LINE(ESP.getMaxFreeBlockSize())
   response->print(" ");
   STATUS_LINE(ESP.getBootMode())
   response->print(" ");
   STATUS_LINE(ESP.getCpuFreqMHz())
   response->print(" ");
   STATUS_LINE(ESP.getFreeSketchSpace())
   response->print(" ");
   STATUS_LINE(ESP.getChipId())
   response->print(" ");
   STATUS_LINE(ESP.getCycleCount())
   response->print(" ");
   STATUS_LINE(ESP.getSketchMD5())
   response->print(" <h2>build info</h2> ");
   STATUS_LINE(sizeof(char))
   response->print(" ");
   STATUS_LINE(sizeof(int))
   response->print(" ");
   STATUS_LINE(sizeof(long int))
   response->print(" ");
   STATUS_LINE(sizeof(long long int))
   response->print(" ");
   STATUS_LINE(sizeof(unsigned))
   response->print(" ");
   STATUS_LINE(sizeof(unsigned char))
   response->print(" ");
   STATUS_LINE(sizeof(unsigned int))
   response->print(" ");
   STATUS_LINE(sizeof(unsigned long int))
   response->print(" ");
   STATUS_LINE(sizeof(unsigned long long int))
   response->print(" ");
   STATUS_LINE(sizeof(float))
   response->print(" ");
   STATUS_LINE(sizeof(double))
   response->print(" ");
   STATUS_LINE(sizeof(double*))
   response->print(" ");
   STATUS_LINE(sizeof(int*))
   response->print(" ");
   STATUS_LINE(sizeof(char*))
   response->print(" ");
   STATUS_LINE(sizeof(&webserver_setup))
   response->print(" ");
   STATUS_LINE(sizeof(&millis))
   response->print(" ");
   STATUS_LINE(sizeof(&ESP.getCycleCount))
   response->print(" </div> </body> <script> for (const e of document.getElementsByTagName(\"input\")) { e.onchange = () => { window.dirty = true; console.log('auto-refresh disabled'); }; }; const interval = setInterval(() => { if (!window.dirty) { location.reload(); } }, ");
   response->print( refresh_interval*1000 );
   response->print("); </script> </html>");
}

